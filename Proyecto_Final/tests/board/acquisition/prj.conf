## CMakeLists.txt
```
cmake_minimum_required(VERSION 3.20.0)

get_filename_component(TRACKER_ROOT "${CMAKE_CURRENT_SOURCE_DIR}/../../.." ABSOLUTE)
option(D4_TIMING_ONLY "Medir tiempos sin consola ni barrido de pilas" OFF)
option(D4_I2C_TEST "Inyeccion I2C y traza, solo en el ensayo" OFF)
if(D4_I2C_TEST)
    set(D4_TIMING_ONLY ON)
endif()
set(CONF_FILE "${TRACKER_ROOT}/confs/prj_nucleo_wl55jc.conf")
set(DTC_OVERLAY_FILE "${TRACKER_ROOT}/boards/nucleo_wl55jc.overlay")
if(NOT D4_TIMING_ONLY)
    list(APPEND CONF_FILE "${CMAKE_CURRENT_SOURCE_DIR}/prj.conf")
    list(APPEND DTC_OVERLAY_FILE "${CMAKE_CURRENT_SOURCE_DIR}/app.overlay")
endif()
if(D4_I2C_TEST)
    list(APPEND DTC_OVERLAY_FILE "${CMAKE_CURRENT_SOURCE_DIR}/i2c_fault.overlay")
endif()

find_package(Zephyr REQUIRED HINTS $ENV{ZEPHYR_BASE})
project(tracker_acquisition_test)

target_include_directories(app PRIVATE "${TRACKER_ROOT}/include")
if(D4_I2C_TEST)
    target_sources(app PRIVATE src/i2c_main.c "${TRACKER_ROOT}/src/build_checks.c")
    target_include_directories(app PRIVATE "${TRACKER_ROOT}/src/acquisition" "${TRACKER_ROOT}/src/drivers")
    target_include_directories(app PRIVATE "${ZEPHYR_BASE}/drivers/i2c")
    foreach(function acquisition_imu_update imu_read imu_check_configuration imu_init
                     imu_recover_bus environment_init environment_start environment_read
                     i2c_stm32_transaction)
        target_link_options(zephyr_interface INTERFACE "-Wl,--wrap=${function}")
    endforeach()
elseif(D4_TIMING_ONLY)
    target_sources(app PRIVATE src/timing_main.c "${TRACKER_ROOT}/src/build_checks.c")
else()
    target_sources(app PRIVATE src/main.c)
endif()
target_sources(app PRIVATE
    "${TRACKER_ROOT}/src/drivers/light.c"
    "${TRACKER_ROOT}/src/drivers/imu.c"
    "${TRACKER_ROOT}/src/drivers/environment.c"
    "${TRACKER_ROOT}/src/algorithms/gyro_calibration.c"
    "${TRACKER_ROOT}/src/algorithms/motion.c"
    "${TRACKER_ROOT}/src/algorithms/estimator.c"
    "${TRACKER_ROOT}/src/algorithms/statistics.c"
    "${TRACKER_ROOT}/src/acquisition/acquisition.c"
    "${TRACKER_ROOT}/src/acquisition/acquisition_imu.c"
    "${TRACKER_ROOT}/src/acquisition/acquisition_light.c"
    "${TRACKER_ROOT}/src/acquisition/acquisition_environment.c"
)
target_compile_options(app PRIVATE -Wall -Wextra -Werror)
target_link_libraries(app PRIVATE m)
```

## prj.conf
```kconfig
# Solo el main de ensayo usa la consola; adquisicion conserva sus fuentes.
CONFIG_CONSOLE=y
CONFIG_UART_CONSOLE=y
CONFIG_PRINTK=y
CONFIG_CBPRINTF_FP_SUPPORT=y
CONFIG_MAIN_STACK_SIZE=3072

# Medicion del margen de pila observado, solo en este perfil de ensayo.
CONFIG_INIT_STACKS=y
CONFIG_THREAD_STACK_INFO=y
```

## app.overlay
```dts
/ {
    chosen {
        zephyr,console = &lpuart1;
    };
};
```

## i2c_fault.overlay
```dts
/ {
    zephyr,user {
        /* D8/PC2: salida solo de ensayo, drenador abierto, inicialmente libre. */
        fault-gpios = <&gpioc 2 (GPIO_ACTIVE_HIGH | GPIO_OPEN_DRAIN)>;
    };
};
```

## src/main.c
```c
#include <zephyr/device.h>
#include <zephyr/drivers/uart.h>
#include <zephyr/kernel.h>
#include <zephyr/sys/printk.h>

#include "acquisition_api.h"

/* Identificador creado por K_THREAD_DEFINE, para medir su pila desde el ensayo. */
extern const k_tid_t acquisition_tid;

static const struct device *const console = DEVICE_DT_GET(DT_CHOSEN(zephyr_console));

/**
 * Calcula la edad de la ultima medida utilizable de una familia.
 * Entradas: now_ms posterior al snapshot; quality apunta a su calidad valida.
 * Retorno: edad en ms, o -1 si nunca hubo una medida utilizable.
 * Modifica: nada; no cambia calidad ni lee hardware.
 */
static int64_t sample_age(int64_t now_ms, const SampleQuality *quality)
{
    return quality->last_good_ms < 0 ? -1 : now_ms - quality->last_good_ms;
}

/**
 * Muestra las medidas publicadas, sus edades, navegacion y avance del hilo.
 * Entradas: snapshot coherente, ahora en ms y diferencias desde el reporte previo.
 * Retorno: ninguno (void).
 * Modifica: escribe por consola; conserva el snapshot y no accede a sensores.
 */
static void snapshot_print(const AcquisitionSnapshot *s, int64_t now_ms,
                           int64_t report_dt_ms, uint32_t progress_delta)
{
    printk("D4 t_ms=%lld progress=%u dp=%u dt_ms=%lld cal=%d moving=%d "
           "imu_ok=%d imu_age=%lld sat=%d nav_ok=%d\n",
           (long long)now_ms, (unsigned)s->progress, (unsigned)progress_delta,
           (long long)report_dt_ms, s->imu.calibration_pending, s->moving,
           s->imu.quality.valid, (long long)sample_age(now_ms, &s->imu.quality),
           s->imu.range_limited, s->nav.valid);
    printk("IMU a=%.5f,%.5f,%.5f gyro=%.5f,%.5f,%.5f\n",
           (double)s->imu.accel_mps2.x, (double)s->imu.accel_mps2.y,
           (double)s->imu.accel_mps2.z, (double)s->imu.gyro_dps.x,
           (double)s->imu.gyro_dps.y, (double)s->imu.gyro_dps.z);
    printk("NAV q=%.6f,%.6f,%.6f,%.6f rel=%.6f,%.6f,%.6f,%.6f "
           "v=%.5f,%.5f,%.5f p=%.5f,%.5f,%.5f\n",
           (double)s->nav.q.w, (double)s->nav.q.x,
           (double)s->nav.q.y, (double)s->nav.q.z,
           (double)s->nav.relative_q.w, (double)s->nav.relative_q.x,
           (double)s->nav.relative_q.y, (double)s->nav.relative_q.z,
           (double)s->nav.velocity_mps.x, (double)s->nav.velocity_mps.y,
           (double)s->nav.velocity_mps.z, (double)s->nav.position_m.x,
           (double)s->nav.position_m.y, (double)s->nav.position_m.z);
    printk("SLOW light_ok=%d light_age=%lld light_pct=%.4f clipped=%d "
           "env_ok=%d env_age=%lld temp_c=%.4f rh_pct=%.4f stats_ready=%d\n",
           s->light.quality.valid, (long long)sample_age(now_ms, &s->light.quality),
           (double)s->light.light_pct, s->light.clipped,
           s->environment.quality.valid,
           (long long)sample_age(now_ms, &s->environment.quality),
           (double)s->environment.temperature_c,
           (double)s->environment.humidity_pct, s->stats.ready);
}

/**
 * Muestra una ventana completa con las cinco metricas originales de D4.
 * Entradas: result apunta a un resultado ready del snapshot.
 * Retorno: ninguno (void).
 * Modifica: escribe limites, conteos y resumen por consola; no recalcula estadisticas.
 */
static void statistics_print(const StatsResult *result)
{
    static const char *const names[STATS_METRIC_COUNT] = {
        "light_pct", "temp_c", "rh_pct", "accel_mps2", "gyro_dps",
    };

    printk("WINDOW begin_ms=%lld end_ms=%lld\n",
           (long long)result->begin_ms, (long long)result->end_ms);
    for (int i = 0; i < STATS_METRIC_COUNT; ++i) {
        const MetricStats *m = &result->metric[i];
        if (m->count == 0U) {
            printk("STAT metric=%s n=0 value=N/D\n", names[i]);
        } else {
            printk("STAT metric=%s n=%u mean=%.6f min=%.6f max=%.6f\n",
                   names[i], (unsigned)m->count, (double)m->mean,
                   (double)m->min, (double)m->max);
        }
    }
}

/**
 * Consulta el espacio de pila que permanece sin usar en los dos hilos del ensayo.
 * Entradas: ninguna explicita; utiliza acquisition_tid y el hilo main actual.
 * Retorno: ninguno (void).
 * Modifica: consulta las marcas de pila de Zephyr y escribe bytes libres o error.
 *           No cambia prioridades ni la pila solicitada por adquisicion (2048 B).
 */
static void stacks_print(void)
{
    size_t acquisition_free = 0;
    size_t main_free = 0;
    int acquisition_ret = k_thread_stack_space_get(acquisition_tid, &acquisition_free);
    int main_ret = k_thread_stack_space_get(k_current_get(), &main_free);

    printk("STACK acquisition_ret=%d acquisition_free=%u main_ret=%d main_free=%u\n",
           acquisition_ret, (unsigned)acquisition_free,
           main_ret, (unsigned)main_free);
}

/**
 * Observa el servicio real y permite abrir/cerrar sesiones estadisticas por UART.
 * Entradas: ninguna explicita; recibe 'b' (begin) o 'e' (end) por LPUART1.
 * Retorno: 0 si la consola no esta disponible; no retorna durante el ensayo.
 * Modifica: abre una sesion inicial, consulta snapshots y emite reportes de 1 s;
 *           b/e llaman a las APIs publicas y reinician la deteccion de ventanas.
 *           No lee sensores directamente ni procesa navegacion o movimiento.
 */
int main(void)
{
    if (!device_is_ready(console)) {
        return 0;
    }

    printk("D4_START service=real commands=b:begin,e:end report_ms=1000\n");
    acquisition_stats_begin();
    printk("SESSION begin t_ms=%lld\n", (long long)k_uptime_get());

    int64_t next_report_ms = 0;
    int64_t previous_report_ms = 0;
    int64_t last_window_end_ms = -1;
    uint32_t previous_progress = 0;

    while (true) {
        unsigned char command;
        if (uart_poll_in(console, &command) == 0) {
            if (command == 'b' || command == 'e') {
                if (command == 'b') {
                    acquisition_stats_begin();
                } else {
                    acquisition_stats_end();
                }
                last_window_end_ms = -1;
                printk("SESSION %s t_ms=%lld\n", command == 'b' ? "begin" : "end",
                       (long long)k_uptime_get());
            }
        }

        AcquisitionSnapshot snapshot;
        acquisition_snapshot_get(&snapshot);
        int64_t now_ms = k_uptime_get();

        if (snapshot.stats.ready && snapshot.stats.end_ms != last_window_end_ms) {
            statistics_print(&snapshot.stats);
            last_window_end_ms = snapshot.stats.end_ms;
        }
        if (now_ms >= next_report_ms) {
            snapshot_print(&snapshot, now_ms, now_ms - previous_report_ms,
                           snapshot.progress - previous_progress);
            stacks_print();
            previous_progress = snapshot.progress;
            previous_report_ms = now_ms;
            next_report_ms = now_ms + 1000;
        }
        k_msleep(100);
    }
}
```

## src/i2c_main.c
```c
#include <errno.h>
#include <limits.h>
#include <soc.h>
#include <zephyr/drivers/gpio.h>
#include <zephyr/drivers/i2c.h>
#include <zephyr/irq.h>
#include <zephyr/kernel.h>

#include "acquisition_api.h"
#include "acquisition_imu.h"
#include "environment.h"
#include "imu.h"
#include "i2c_stm32.h" /* Diagnostico privado STM32, exclusivo de este ensayo. */

#define TRACE_CAPACITY 96U
#define TRACE_DURATION_MS 15000

enum TestCommand { TEST_SLEEP = 1, TEST_RESET, TEST_SDA_BRIEF, TEST_SDA_LONG,
                   TEST_THREE_ERRORS, TEST_ENV_RESET, TEST_BUS_CLEAR, TEST_ENV_PROBE,
                   TEST_ENV_ID };
enum EventKind { EV_INJECT = 1, EV_HOLD_BEGIN, EV_HOLD_END, EV_READ, EV_CHECK,
                 EV_INIT, EV_RECOVER, EV_ENV_START, EV_ENV_READ, EV_STATE, EV_ENV_INIT,
                 EV_TRANSFER, EV_ID, EV_ID_CRC_RAW };
enum TestPhase { TEST_IDLE, TEST_ARMED, TEST_HOLDING, TEST_DONE, TEST_ERROR };

typedef struct {
    uint32_t t_ms;
    uint32_t cycle;
    uint32_t kind;
    int32_t result;
    uint32_t elapsed_cycles;
    uint32_t detail;
} TestEvent;

/* Solo existe en esta imagen. command se escribe deliberadamente por SWD. */
static volatile struct {
    uint32_t command;
    uint32_t phase;
    uint32_t last_command;
    int32_t gpio_init_result;
    uint32_t injected_ms;
    uint32_t released_ms;
    int32_t inject_result;
    uint32_t event_count;
    uint32_t dropped;
    uint32_t new_count;
    uint32_t no_new_count;
    uint32_t error_count;
    uint32_t update_max_cycles;
    uint32_t hold_cycles;
    uint32_t cycle;
    uint32_t last_failed_remaining;
    TestEvent events[TRACE_CAPACITY];
} i2c_test;

static const struct gpio_dt_spec fault_pin =
    GPIO_DT_SPEC_GET(DT_PATH(zephyr_user), fault_gpios);
static const struct device *const bus = DEVICE_DT_GET(DT_NODELABEL(i2c2));
static volatile int64_t trace_until_ms;
static volatile uint32_t pending_command;
static volatile unsigned int errors_remaining;
static volatile int last_read_result = INT_MIN;
static volatile uint32_t last_read_detail = UINT32_MAX;
static volatile uint32_t last_state_flags = UINT32_MAX;

bool __real_acquisition_imu_update(AcquisitionImu *ctx);
int __real_imu_read(ImuReading *out);
int __real_imu_check_configuration(bool *matches);
int __real_imu_init(void);
int __real_imu_recover_bus(void);
int __wrap_imu_recover_bus(void);
int __real_environment_init(void);
int __real_environment_start(void);
int __real_environment_read(EnvironmentReading *out);
int __real_i2c_stm32_transaction(const struct device *dev, struct i2c_msg msg,
                                 uint8_t *next_msg_flags, uint16_t target);

/**
 * Indica si sigue abierta la captura de 15 s de este caso.
 * Entradas: ninguna explicita; consulta el reloj y trace_until_ms.
 * Retorno: true mientras la captura esta activa.
 * Modifica: nada; no accede a sensores.
 */
static bool trace_active(void)
{
    return k_uptime_get() < trace_until_ms;
}

/**
 * Guarda un evento de prueba, sin imprimir ni realizar transferencias.
 * Entradas: tipo, resultado, duracion en ciclos y detalle propio del tipo.
 * Retorno: ninguno (void).
 * Modifica: eventos/contador o dropped durante 15 s. Protege solo la copia
 *           breve de RAM frente a los dos productores (main e hilo D4).
 */
static void trace_add(uint32_t kind, int result, uint32_t elapsed, uint32_t detail)
{
    if (!trace_active()) { return; }
    unsigned int key = irq_lock();
    uint32_t index = i2c_test.event_count;
    if (index < TRACE_CAPACITY) {
        i2c_test.events[index] = (TestEvent){
            .t_ms = (uint32_t)k_uptime_get(), .cycle = i2c_test.cycle,
            .kind = kind, .result = result, .elapsed_cycles = elapsed, .detail = detail,
        };
        i2c_test.event_count = index + 1U;
    } else {
        i2c_test.dropped++;
    }
    irq_unlock(key);
}

/**
 * Lee una vez la segunda mitad del identificador electronico del Si7021.
 * Entradas: ninguna explicita; bus real disponible en el hilo D4 del ensayo.
 * Retorno: resultado I2C; no convierte un ID diferente en error de bus.
 * Modifica: traza con bytes SNB_3/2/1/0 y los CRC brutos, solo si se recibieron.
 *           No autentica el identificador ni altera la validacion CRC de RH.
 *           No configura el sensor ni incorpora esta consulta a produccion.
 */
static int test_environment_identify(void)
{
    const uint8_t command[2] = {0xFC, 0xC9};
    uint8_t serial[6];
    int ret = i2c_write_read(bus, 0x40, command, sizeof(command), serial, sizeof(serial));
    if (ret == 0) {
        uint32_t id = ((uint32_t)serial[0] << 24) | ((uint32_t)serial[1] << 16) |
                      ((uint32_t)serial[3] << 8) | serial[4];
        trace_add(EV_ID, 0, 0, id);
        trace_add(EV_ID_CRC_RAW, 0, 0,
                  ((uint32_t)serial[2] << 8) | serial[5]);
    }
    return ret;
}

/**
 * Observa cada mensaje ambiental y los mensajes fallidos del bus real.
 * Entradas: dev, msg, siguiente flags y direccion tal como los recibe STM32.
 * Retorno: resultado original de la transferencia, sin reintentos adicionales.
 * Modifica: hardware y buffer mediante la funcion real; despues solo la traza.
 *           detail: direccion[31:24], flags[23:16], longitud[15:12],
 *           errores NACK/ARLO/ERR en bits 8/9/10 y primer byte en [7:0].
 *           Un buffer de lectura fallida no se consulta. La cabecera privada
 *           permite distinguir causas que STM32 agrupa bajo -EIO.
 */
int __wrap_i2c_stm32_transaction(const struct device *dev, struct i2c_msg msg,
                                uint8_t *next_msg_flags, uint16_t target)
{
    uint32_t begin = k_cycle_get_32();
    int ret = __real_i2c_stm32_transaction(dev, msg, next_msg_flags, target);
    uint32_t elapsed = k_cycle_get_32() - begin;
    if (target == 0x40U || ret < 0) {
        const struct i2c_stm32_data *data = dev->data;
        uint32_t errors = (data->current.is_nack ? 1U : 0U) |
                          (data->current.is_arlo ? 2U : 0U) |
                          (data->current.is_err ? 4U : 0U);
        uint32_t first = msg.len > 0U &&
                         (ret == 0 || (msg.flags & I2C_MSG_READ) == 0U) ? msg.buf[0] : 0U;
        uint32_t detail = ((uint32_t)target << 24) | ((uint32_t)msg.flags << 16) |
                          ((msg.len & 15U) << 12) | (errors << 8) | first;
        if (target == 0x40U && ret < 0) {
            i2c_test.last_failed_remaining = data->current.len;
        }
        trace_add(EV_TRANSFER, ret, elapsed, detail);
    }
    return ret;
}

/**
 * Abre un caso nuevo y descarta solo la traza anterior de este ensayo.
 * Entradas: command entre TEST_SLEEP y TEST_ENV_ID.
 * Retorno: ninguno (void).
 * Modifica: contadores/ventana de prueba y peticion que consumira el hilo D4;
 *           conserva todos los contextos y diagnosticos de produccion.
 */
static void test_arm(uint32_t command)
{
    unsigned int key = irq_lock();
    i2c_test.phase = TEST_ARMED;
    i2c_test.last_command = command;
    i2c_test.injected_ms = 0;
    i2c_test.released_ms = 0;
    i2c_test.inject_result = 0;
    i2c_test.event_count = 0;
    i2c_test.dropped = 0;
    i2c_test.new_count = 0;
    i2c_test.no_new_count = 0;
    i2c_test.error_count = 0;
    i2c_test.update_max_cycles = 0;
    i2c_test.hold_cycles = 0;
    i2c_test.last_failed_remaining = 0;
    last_read_result = INT_MIN;
    last_read_detail = UINT32_MAX;
    last_state_flags = UINT32_MAX;
    errors_remaining = 0;
    trace_until_ms = k_uptime_get() + TRACE_DURATION_MS;
    pending_command = command != TEST_SDA_BRIEF && command != TEST_SDA_LONG ? command : 0U;
    irq_unlock(key);
}

/**
 * Cuenta vueltas y observa cambios de estado alrededor del modulo IMU real.
 * Entradas: ctx es el contexto privado real recibido desde el coordinador.
 * Retorno: el bool devuelto por la implementacion real.
 * Modifica: ctx mediante el modulo real y solo diagnosticos de ensayo adicionales.
 *           Flags: 1=configurado, 2=IMU valida, 4=nav valida, 8=cal pendiente,
 *           16=revision pendiente, 32=saturacion, 64=movimiento.
 */
bool __wrap_acquisition_imu_update(AcquisitionImu *ctx)
{
    i2c_test.cycle++;
    uint32_t begin = k_cycle_get_32();
    bool ret = __real_acquisition_imu_update(ctx);
    uint32_t elapsed = k_cycle_get_32() - begin;
    if (trace_active()) {
        if (elapsed > i2c_test.update_max_cycles) { i2c_test.update_max_cycles = elapsed; }
        uint32_t flags = (ctx->configured ? 1U : 0U) | (ctx->data.quality.valid ? 2U : 0U) |
            (ctx->nav.valid ? 4U : 0U) | (ctx->data.calibration_pending ? 8U : 0U) |
            (ctx->review_pending ? 16U : 0U) | (ctx->data.range_limited ? 32U : 0U) |
            (ctx->moving ? 64U : 0U);
        if (flags != last_state_flags) {
            trace_add(EV_STATE, (int)flags, elapsed, 0);
            last_state_flags = flags;
        }
    }
    return ret;
}

/**
 * Atiende una inyeccion pendiente desde el mismo hilo que posee I2C y lee IMU.
 * Entradas: out valido como en imu_read; peticion escrita solo por main de ensayo.
 * Retorno: resultado real, NO_NEW tras inyeccion correcta, o tres -EIO simulados.
 * Modifica: MPU real al inyectar PWR, Si7021 con reset diagnostico o el bus
 *           mediante un bus clear o direccionamiento sin datos (solo ensayo);
 *           out solo como lo permita imu_read real.
 *           Cuenta resultados y registra errores/cambios; detalle READ 0=real,
 *           1=invocacion sustituida por diagnostico I2C, 2=error simulado.
 */
int __wrap_imu_read(ImuReading *out)
{
    uint32_t begin = k_cycle_get_32();
    uint32_t detail = 0;
    int ret;
    uint32_t command = pending_command;
    pending_command = 0;
    if (command == TEST_THREE_ERRORS) { errors_remaining = 3; }

    if (command == TEST_SLEEP || command == TEST_RESET || command == TEST_ENV_RESET ||
        command == TEST_BUS_CLEAR || command == TEST_ENV_PROBE || command == TEST_ENV_ID) {
        uint8_t value = command == TEST_SLEEP ? 0x49U :
                        command == TEST_RESET ? 0x80U :
                        command == TEST_ENV_RESET ? 0xFEU : 0xFFU;
        if (command == TEST_ENV_ID) { ret = test_environment_identify(); }
        else if (command == TEST_ENV_PROBE) { ret = i2c_write(bus, NULL, 0, 0x40); }
        else if (command == TEST_BUS_CLEAR) { ret = __wrap_imu_recover_bus(); }
        else if (command == TEST_ENV_RESET) { ret = i2c_write(bus, &value, 1, 0x40); }
        else { ret = i2c_reg_write_byte(bus, 0x68, 0x6B, value); }
        i2c_test.injected_ms = (uint32_t)k_uptime_get();
        i2c_test.inject_result = ret;
        i2c_test.phase = ret == 0 ? TEST_DONE : TEST_ERROR;
        trace_add(EV_INJECT, ret, k_cycle_get_32() - begin, value);
        ret = ret < 0 ? ret : IMU_NO_NEW;
        detail = 1;
    } else if (errors_remaining > 0U) {
        errors_remaining--;
        ret = -EIO;
        detail = 2;
        if (i2c_test.injected_ms == 0U) { i2c_test.injected_ms = (uint32_t)k_uptime_get(); }
        if (errors_remaining == 0U) { i2c_test.phase = TEST_DONE; }
    } else {
        ret = __real_imu_read(out);
    }

    if (trace_active()) {
        if (ret == IMU_NEW) { i2c_test.new_count++; }
        else if (ret == IMU_NO_NEW) { i2c_test.no_new_count++; }
        else { i2c_test.error_count++; }
        if (ret < 0 || ret != last_read_result || detail != last_read_detail) {
            trace_add(EV_READ, ret, k_cycle_get_32() - begin, detail);
        }
        last_read_result = ret;
        last_read_detail = detail;
    }
    return ret;
}

/**
 * Observa la comprobacion real de PWR/escalas sin alterar su resultado.
 * Entradas: matches valido. Retorno: resultado real; matches cambia solo en exito.
 * Modifica: la salida permitida por el driver y traza; detalle 1=coincide, 0=no.
 */
int __wrap_imu_check_configuration(bool *matches)
{
    uint32_t begin = k_cycle_get_32();
    int ret = __real_imu_check_configuration(matches);
    trace_add(EV_CHECK, ret, k_cycle_get_32() - begin, ret == 0 && *matches ? 1U : 0U);
    return ret;
}

/**
 * Observa el init real, incluidas sus esperas. Entradas: ninguna explicita.
 * Retorno: resultado real. Modifica: hardware mediante el driver y traza.
 */
int __wrap_imu_init(void)
{
    uint32_t begin = k_cycle_get_32();
    int ret = __real_imu_init();
    trace_add(EV_INIT, ret, k_cycle_get_32() - begin, 0);
    return ret;
}

/**
 * Observa los pulsos reales de recuperacion. Entradas: ninguna explicita.
 * Retorno: resultado real. Modifica: bus mediante Zephyr y traza de ensayo.
 */
int __wrap_imu_recover_bus(void)
{
    uint32_t begin = k_cycle_get_32();
    int ret = __real_imu_recover_bus();
    trace_add(EV_RECOVER, ret, k_cycle_get_32() - begin, 0);
    return ret;
}

/**
 * Observa la configuracion ambiental real, incluidos los reintentos fallidos.
 * Entradas: ninguna explicita. Retorno: resultado real de environment_init.
 * Modifica: Si7021 mediante el driver y traza; conserva el resultado original.
 */
int __wrap_environment_init(void)
{
    uint32_t begin = k_cycle_get_32();
    int ret = __real_environment_init();
    trace_add(EV_ENV_INIT, ret, k_cycle_get_32() - begin, 0);
    return ret;
}

/**
 * Observa F5 real. Entradas: ninguna explicita. Retorno: resultado del driver.
 * Modifica: sensor ambiental mediante el driver y traza; no espera conversion.
 */
int __wrap_environment_start(void)
{
    uint32_t begin = k_cycle_get_32();
    int ret = __real_environment_start();
    trace_add(EV_ENV_START, ret, k_cycle_get_32() - begin, 0);
    return ret;
}

/**
 * Observa la recogida ambiental real. Entradas: out valido como en el driver.
 * Retorno: resultado real. Modifica: out solo en exito, hardware y traza.
 */
int __wrap_environment_read(EnvironmentReading *out)
{
    uint32_t begin = k_cycle_get_32();
    int ret = __real_environment_read(out);
    trace_add(EV_ENV_READ, ret, k_cycle_get_32() - begin, 0);
    return ret;
}

/**
 * Ejecuta solo el fixture GPIO y arma las peticiones del ensayo por SWD.
 * Entradas: command 1=SLEEP, 2=RESET, 3=SDA 60 ms, 4=SDA 5 s, 5=tres -EIO,
 *           6=reset Si7021, 7=bus clear, 8=sondeo 0x40, 9=identificacion FC/C9.
 * Retorno: 0 si no puede preparar D8; no retorna durante el ensayo normal.
 * Modifica: D8/PC2 en drenador abierto (1=liberado), traza y sesion estadistica.
 *           Main no realiza I2C; todas las inyecciones I2C usan el hilo D4.
 */
int main(void)
{
    int ret = gpio_is_ready_dt(&fault_pin) ?
        gpio_pin_configure_dt(&fault_pin, GPIO_OUTPUT_HIGH) : -ENODEV;
    i2c_test.gpio_init_result = ret;
    if (ret != 0) { i2c_test.phase = TEST_ERROR; return 0; }
    acquisition_stats_begin();

    while (true) {
        uint32_t command = i2c_test.command;
        if (command >= TEST_SLEEP && command <= TEST_ENV_ID) {
            i2c_test.command = 0;
            test_arm(command);
            if (command == TEST_SDA_BRIEF || command == TEST_SDA_LONG) {
                i2c_test.phase = TEST_HOLDING;
                uint32_t begin = k_cycle_get_32();
                ret = gpio_pin_set_dt(&fault_pin, 0);
                i2c_test.injected_ms = (uint32_t)k_uptime_get();
                i2c_test.inject_result = ret;
                trace_add(EV_HOLD_BEGIN, ret, 0, command);
                if (ret == 0) { k_msleep(command == TEST_SDA_BRIEF ? 60 : 5000); }
                int release_ret = gpio_pin_set_dt(&fault_pin, 1);
                i2c_test.hold_cycles = k_cycle_get_32() - begin;
                i2c_test.released_ms = (uint32_t)k_uptime_get();
                i2c_test.phase = ret == 0 && release_ret == 0 ? TEST_DONE : TEST_ERROR;
                trace_add(EV_HOLD_END, release_ret, i2c_test.hold_cycles,
                          (uint32_t)gpio_pin_get_dt(&fault_pin));
            }
        }
        k_msleep(10);
    }
}
```

## src/timing_main.c
```c
#include <zephyr/kernel.h>

#include "acquisition_api.h"

/**
 * Activa estadisticas reales para medir adquisicion sin salida de diagnostico.
 * Entradas: ninguna explicita; el hilo D4 se crea estaticamente como en produccion.
 * Retorno: no retorna durante el ensayo (firma int de main).
 * Modifica: abre una sesion estadistica; despues duerme y deja trabajar al servicio.
 *           No lee sensores, imprime, barre pilas ni altera sus prioridades.
 */
int main(void)
{
    acquisition_stats_begin();
    while (true) {
        k_msleep(1000);
    }
}
```
