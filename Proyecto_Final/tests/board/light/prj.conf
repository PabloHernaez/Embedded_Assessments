## CMakeLists.txt
```
cmake_minimum_required(VERSION 3.20.0)

get_filename_component(TRACKER_ROOT "${CMAKE_CURRENT_SOURCE_DIR}/../../.." ABSOLUTE)

set(CONF_FILE
    "${TRACKER_ROOT}/confs/prj_nucleo_wl55jc.conf"
    "${CMAKE_CURRENT_SOURCE_DIR}/prj.conf"
)
set(DTC_OVERLAY_FILE
    "${TRACKER_ROOT}/boards/nucleo_wl55jc.overlay"
    "${CMAKE_CURRENT_SOURCE_DIR}/app.overlay"
)

find_package(Zephyr REQUIRED HINTS $ENV{ZEPHYR_BASE})
project(tracker_light_test)

target_include_directories(app PRIVATE
    "${TRACKER_ROOT}/include"
    "${TRACKER_ROOT}/src/drivers"
)
target_sources(app PRIVATE src/main.c "${TRACKER_ROOT}/src/drivers/light.c")
```

## prj.conf
```kconfig
# Consola exclusiva del ensayo, sobre la configuracion comun de produccion.
CONFIG_CONSOLE=y
CONFIG_UART_CONSOLE=y
CONFIG_PRINTK=y
```

## src/main.c
```c
#include <zephyr/kernel.h>
#include <zephyr/sys/printk.h>

#include "light.h"

/**
 * Muestra una conversion ADC bruta cada 500 ms para caracterizar el LDR.
 * Entradas: ninguna explicita; usa el montaje ADC1/canal 5/PB1 del overlay comun.
 * Retorno: 0 si falla la inicializacion; en funcionamiento mantiene el bucle.
 * Modifica: configura el ADC, lee una conversion por vuelta y escribe por consola
 *           la fecha y raw o el error. No convierte a porcentaje ni cambia calibracion.
 */
int main(void)
{
    k_msleep(100);
    printk("LDR_RAW_START ADC1_CH5_PB1 period_ms=500\n");

    int ret = light_init();
    printk("light_init=%d\n", ret);
    if (ret < 0) {
        return 0;
    }

    while (true) {
        int16_t raw;
        ret = light_read_raw(&raw);
        long long now_ms = (long long)k_uptime_get();

        if (ret == 0) {
            printk("t_ms=%lld raw=%d\n", now_ms, (int)raw);
        } else {
            printk("t_ms=%lld err=%d\n", now_ms, ret);
        }
        k_msleep(500);
    }
}
```
