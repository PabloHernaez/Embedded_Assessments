## CMakeLists.txt
```
cmake_minimum_required(VERSION 3.20.0)

get_filename_component(TRACKER_ROOT "${CMAKE_CURRENT_SOURCE_DIR}/../../.." ABSOLUTE)

set(CONF_FILE
    "${TRACKER_ROOT}/confs/prj_nucleo_wl55jc.conf"
    "${CMAKE_CURRENT_SOURCE_DIR}/prj.conf"
)
set(DTC_OVERLAY_FILE "${TRACKER_ROOT}/boards/nucleo_wl55jc.overlay")

find_package(Zephyr REQUIRED HINTS $ENV{ZEPHYR_BASE})
project(tracker_simu_bringup)

target_include_directories(app PRIVATE
    "${TRACKER_ROOT}/include"
    "${TRACKER_ROOT}/src/drivers"
    "${TRACKER_ROOT}/src/app"
)

target_sources(app PRIVATE
    src/main.c
    "${TRACKER_ROOT}/src/app/tracker_status.c"
    "${TRACKER_ROOT}/src/drivers/light.c"
    "${TRACKER_ROOT}/src/drivers/imu.c"
    "${TRACKER_ROOT}/src/drivers/environment.c"
    "${TRACKER_ROOT}/src/algorithms/gyro_calibration.c"
    "${TRACKER_ROOT}/src/algorithms/motion.c"
    "${TRACKER_ROOT}/src/algorithms/estimator.c"
    "${TRACKER_ROOT}/src/algorithms/statistics.c"
    "${TRACKER_ROOT}/src/acquisition/acquisition.c"
    "${TRACKER_ROOT}/src/acquisition/acquisition_imu.c"
    "${TRACKER_ROOT}/src/acquisition/acquisition_light.c"
    "${TRACKER_ROOT}/src/acquisition/acquisition_environment.c"
    "${TRACKER_ROOT}/src/telemetry/simu_frame.c"
    "${TRACKER_ROOT}/src/gps/gps.c"
)

target_link_libraries(app PRIVATE m)
```

## prj.conf
```kconfig
CONFIG_SERIAL=y
CONFIG_CONSOLE=n
CONFIG_UART_CONSOLE=n
CONFIG_PRINTK=n
CONFIG_LOG=n
CONFIG_BOOT_BANNER=n
CONFIG_SHELL=n
```

## src/main.c
```c
#include <errno.h>

#include <zephyr/device.h>
#include <zephyr/devicetree.h>
#include <zephyr/drivers/uart.h>
#include <zephyr/kernel.h>

#include "acquisition_api.h"
#include "simu_frame.h"
#include "gps_api.h"
#include "tracker_status.h"

K_TIMER_DEFINE(simu_timer, NULL, NULL);

static const struct device *const simu_uart =
    DEVICE_DT_GET(DT_NODELABEL(lpuart1));

int main(void)
{
    char frame[SIMU_FRAME_BUFFER_SIZE];
    uint16_t seq = 0U;
    TrackerHealth health = { .healthy_since_ms = -1 };

    if (!device_is_ready(simu_uart)) {
        return -ENODEV;
    }

    k_timer_start(&simu_timer, K_MSEC(100), K_MSEC(100));

    while (true) {
        k_timer_status_sync(&simu_timer);

        AcquisitionSnapshot snapshot;
        acquisition_snapshot_get(&snapshot);

        GpsSnapshot gps;
        gps_snapshot_get(&gps);

        const int64_t now_ms = k_uptime_get();
        const TrackerStatus status =
            tracker_status_from_snapshots(&health, &snapshot, &gps, now_ms, false);
        const SimuFrameInput input = {
            .acquisition = &snapshot,
            .gps = &gps,
            .status = &status,
            .seq = seq,
            .uptime_ms = (uint64_t)now_ms,
        };

        int err = simu_frame_encode(&input, frame);
        if (err != 0) {
            return err;
        }

        for (size_t i = 0U; i < SIMU_FRAME_WIRE_SIZE; ++i) {
            uart_poll_out(simu_uart, (unsigned char)frame[i]);
        }
        ++seq;
    }
}
```
