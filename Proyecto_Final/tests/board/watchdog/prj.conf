## CMakeLists.txt
```
cmake_minimum_required(VERSION 3.20.0)

# Ensayo P4-14: firmware de produccion completo mas blocker.c, que bloquea un hilo
# a los 10 s. Caso: -DWDT_CASE=acquisition | gps | main | irq
set(WDT_CASE "acquisition" CACHE STRING "Hilo que se bloquea")

get_filename_component(TRACKER_ROOT "${CMAKE_CURRENT_SOURCE_DIR}/../../.." ABSOLUTE)
set(CONF_FILE "${TRACKER_ROOT}/confs/prj_nucleo_wl55jc.conf")
set(DTC_OVERLAY_FILE "${TRACKER_ROOT}/boards/nucleo_wl55jc.overlay")

find_package(Zephyr REQUIRED HINTS $ENV{ZEPHYR_BASE})
project(tracker_watchdog_test)

target_include_directories(app PRIVATE "${TRACKER_ROOT}/include" "${TRACKER_ROOT}/src")
target_compile_definitions(app PRIVATE WDT_CASE_${WDT_CASE}=1)
target_sources(app PRIVATE
    src/blocker.c
    "${TRACKER_ROOT}/src/main.c"
    "${TRACKER_ROOT}/src/app/tracker_status.c"
    "${TRACKER_ROOT}/src/app/board_ui.c"
    "${TRACKER_ROOT}/src/app/output.c"
    "${TRACKER_ROOT}/src/telemetry/human_report.c"
    "${TRACKER_ROOT}/src/telemetry/simu_frame.c"
    "${TRACKER_ROOT}/src/build_checks.c"
    "${TRACKER_ROOT}/src/drivers/light.c"
    "${TRACKER_ROOT}/src/drivers/imu.c"
    "${TRACKER_ROOT}/src/drivers/environment.c"
    "${TRACKER_ROOT}/src/algorithms/imu_calibration.c"
    "${TRACKER_ROOT}/src/algorithms/motion.c"
    "${TRACKER_ROOT}/src/algorithms/estimator.c"
    "${TRACKER_ROOT}/src/algorithms/statistics.c"
    "${TRACKER_ROOT}/src/acquisition/acquisition.c"
    "${TRACKER_ROOT}/src/acquisition/acquisition_imu.c"
    "${TRACKER_ROOT}/src/acquisition/acquisition_light.c"
    "${TRACKER_ROOT}/src/acquisition/acquisition_environment.c"
    "${TRACKER_ROOT}/src/gps/gps.c"
    "${TRACKER_ROOT}/src/gps/nmea.c"
)
target_link_libraries(app PRIVATE m)
```

## prj.conf
```kconfig
CONFIG_WATCHDOG=y
CONFIG_HWINFO=y
CONFIG_SERIAL=y
CONFIG_CONSOLE=y
CONFIG_UART_CONSOLE=y
CONFIG_PRINTK=y
CONFIG_BOOT_BANNER=n
```

## src/main.c
```c
#include <errno.h>
#include <zephyr/device.h>
#include <zephyr/devicetree.h>
#include <zephyr/drivers/hwinfo.h>
#include <zephyr/drivers/uart.h>
#include <zephyr/kernel.h>
#include <zephyr/sys/atomic.h>
#include <zephyr/sys/printk.h>

#include "app_watchdog.h"

struct producer {
    atomic_t progress;
    int period_ms;
};

static struct producer acq = { .period_ms = 20 };
static struct producer gps = { .period_ms = 200 };

static void produce(void *arg, void *p2, void *p3)
{
    ARG_UNUSED(p2);
    ARG_UNUSED(p3);

    struct producer *const source = arg;
    while (true) {
        atomic_inc(&source->progress);
        k_msleep(source->period_ms);
    }
}

K_THREAD_DEFINE(test_acq, 768, produce, &acq, NULL, NULL, 3, 0, 0);
K_THREAD_DEFINE(test_gps, 768, produce, &gps, NULL, NULL, 5, 0, 0);

int main(void)
{
    const struct device *const uart = DEVICE_DT_GET(DT_NODELABEL(lpuart1));
    if (!device_is_ready(uart)) {
        return -ENODEV;
    }

    uint32_t cause = 0U;
    if (hwinfo_get_reset_cause(&cause) == 0) {
        (void)hwinfo_clear_reset_cause();
    } else {
        cause = 0U;
    }
    printk("BANCO IWDG RESET=0x%08x WATCHDOG=%u\n", (unsigned int)cause,
           (unsigned int)((cause & RESET_WATCHDOG) != 0U));

    app_watchdog_start();
    int err = app_watchdog_observe((uint32_t)atomic_get(&acq.progress),
                                   (uint32_t)atomic_get(&gps.progress));
    if (err != 0) {
        printk("IWDG ERROR %d\n", err);
        return err;
    }
    printk("IWDG activo. Envia a=adquisicion, g=GPS o m=main.\n");

    bool fault_injected = false;
    while (true) {
        err = app_watchdog_observe((uint32_t)atomic_get(&acq.progress),
                                   (uint32_t)atomic_get(&gps.progress));
        if (err != 0) {
            printk("IWDG FEED ERROR %d\n", err);
        }

        unsigned char key;
        if (!fault_injected && uart_poll_in(uart, &key) == 0) {
            switch (key) {
            case 'a':
                printk("Parar adquisicion\n");
                k_thread_suspend(test_acq);
                fault_injected = true;
                break;
            case 'g':
                printk("Parar GPS\n");
                k_thread_suspend(test_gps);
                fault_injected = true;
                break;
            case 'm':
                printk("Parar main\n");
                k_thread_suspend(k_current_get());
                break;
            }
        }
        k_msleep(100);
    }
}
```

## src/blocker.c
```c
/*
 * Ensayo P4-14: con el firmware de produccion intacto, bloquea un hilo a los
 * 10 s del arranque. Su canal de task_wdt deja de alimentarse y el sistema se
 * reinicia; tras el reinicio el informe TEST muestra la causa (RESET=...).
 *   acquisition / gps / main: se suspende ese hilo -> task_wdt -> sys_reboot
 *   irq: interrupciones bloqueadas -> task_wdt no puede alimentar el IWDG -> IWDG
 */
#include <zephyr/kernel.h>

#define BLOCK_AFTER_MS 10000

extern const k_tid_t acquisition_tid; /* K_THREAD_DEFINE en acquisition.c */
extern const k_tid_t gps_tid;         /* K_THREAD_DEFINE en gps.c */
extern struct k_thread z_main_thread; /* hilo main del kernel (solo para el ensayo) */

static void blocker(void *p1, void *p2, void *p3)
{
    ARG_UNUSED(p1);
    ARG_UNUSED(p2);
    ARG_UNUSED(p3);

    k_msleep(BLOCK_AFTER_MS);

#if defined(WDT_CASE_acquisition)
    k_thread_suspend(acquisition_tid);
#elif defined(WDT_CASE_gps)
    k_thread_suspend(gps_tid);
#elif defined(WDT_CASE_main)
    k_thread_suspend(&z_main_thread);
#elif defined(WDT_CASE_irq)
    (void)irq_lock();
    while (true) {
    }
#else
#error "WDT_CASE desconocido"
#endif
}

/* Prioridad 1: por encima de los tres hilos del firmware para que el bloqueo sea inmediato. */
K_THREAD_DEFINE(blocker_tid, 512, blocker, NULL, NULL, NULL, 1, 0, 0);
```
